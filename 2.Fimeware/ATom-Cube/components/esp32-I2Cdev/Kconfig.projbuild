## 2.Fimeware/ATom-Cube/components/esp32-I2Cdev/Kconfig.projbuild
```kconfig
menu "I2Cdev library"

    config I2C_BUS_ACCESS_TIMEOUT
        int
        prompt "Timeout for waiting for I2C bus mutex to be available"
        default 100

    config I2C_BUS_DEFAULT_READ_TIMEOUT
        int
        prompt "Timeout for reading from I2C bus"
        default 1000
        
endmenu
```

## 2.Fimeware/Atom-Bot-Button/board/Kconfig
```kconfig
menu "Hardware Drivers Config"

config SOC_STM32F103RC
    bool
    select SOC_SERIES_STM32F1
    select RT_USING_COMPONENTS_INIT
    select RT_USING_USER_MAIN
    default y

menu "Onboard Peripheral Drivers"

endmenu

menu "On-chip Peripheral Drivers"

    config BSP_USING_GPIO
        bool "Enable GPIO"
        select RT_USING_PIN
        default y

    menuconfig BSP_USING_UART
        bool "Enable UART"
        default y
        select RT_USING_SERIAL
        if BSP_USING_UART
            menuconfig BSP_USING_UART1
                bool "Enable UART1 (Debugger)"
                default y
                if BSP_USING_UART1
                    config BSP_UART1_RX_USING_DMA
                        bool "Enable UART1 RX DMA"
                        depends on BSP_USING_UART1 && RT_SERIAL_USING_DMA
                        default n

                    config BSP_UART1_TX_USING_DMA
                        bool "Enable UART1 TX DMA"
                        depends on BSP_USING_UART1 && RT_SERIAL_USING_DMA
                        default n

                    config BSP_UART1_RX_BUFSIZE
                        int "Set UART1 RX buffer size"
                        range 64 65535
                        depends on RT_USING_SERIAL_V2
                        default 256

                    config BSP_UART1_TX_BUFSIZE
                        int "Set UART1 TX buffer size"
                        range 0 65535
                        depends on RT_USING_SERIAL_V2
                        default 0
                endif

            menuconfig BSP_USING_UART3
                bool "Enable UART3"
                default n
                if BSP_USING_UART3
                    config BSP_UART3_RX_USING_DMA
                        bool "Enable UART3 RX DMA"
                        depends on BSP_USING_UART3 && RT_SERIAL_USING_DMA
                        default n

                    config BSP_UART3_TX_USING_DMA
                        bool "Enable UART3 TX DMA"
                        depends on BSP_USING_UART3 && RT_SERIAL_USING_DMA
                        default n

                    config BSP_UART3_RX_BUFSIZE
                        int "Set UART3 RX buffer size"
                        range 64 65535
                        depends on RT_USING_SERIAL_V2
                        default 256

                    config BSP_UART3_TX_BUFSIZE
                        int "Set UART3 TX buffer size"
                        range 0 65535
                        depends on RT_USING_SERIAL_V2
                        default 256
                endif
        endif

    menuconfig BSP_USING_TIM
        bool "Enable timer"
        default n
        select RT_USING_HWTIMER
        if BSP_USING_TIM
            config BSP_USING_TIM4
                bool "Enable TIM4"
                default n
        endif

    menuconfig BSP_USING_SPI
        bool "Enable SPI BUS"
        default n
        select RT_USING_SPI
        if BSP_USING_SPI
            config BSP_USING_SPI1
                bool "Enable SPI1 BUS"
                default n

            config BSP_SPI1_TX_USING_DMA
                bool "Enable SPI1 TX DMA"
                depends on BSP_USING_SPI1
                default n
                
            config BSP_SPI1_RX_USING_DMA
                bool "Enable SPI1 RX DMA"
                depends on BSP_USING_SPI1
                select BSP_SPI1_TX_USING_DMA
                default n
        endif

    config BSP_USING_ON_CHIP_FLASH
        bool "Enable on-chip FLASH"
        select RT_USING_FAL
        default n

    config BSP_USING_ON_CHIP_FLASH_FATFS
        bool "Enable onchip flash with FatFS"
        depends on BSP_USING_ON_CHIP_FLASH
        select RT_USING_DFS
        select RT_USING_DFS_ELMFAT
        default n

    menuconfig BSP_USING_HW_I2C
        bool "Enable Hardware I2C Bus"
        default n
        select RT_USING_I2C
        select RT_USING_PIN
        if BSP_USING_HW_I2C
            config BSP_USING_HW_I2C2
                bool "Enable I2C2 Bus (HW I2C)"
                default n
                if BSP_USING_HW_I2C2
                    config BSP_I2C2_SCL_PIN
                        int "i2c2 SCL pin number"
                        range 1 63
                        default 26
                    config BSP_I2C2_SDA_PIN
                        int "i2c2 SDA pin number"
                        range 1 63
                        default 27
                endif
        endif

    menuconfig BSP_USING_I2C
        bool "Enable Software I2C Bus"
        default n
        select RT_USING_I2C
        select RT_USING_I2C_BITOPS
        select RT_USING_PIN
        if BSP_USING_I2C
            config BSP_USING_I2C1
                bool "Enable I2C1 Bus (User I2C)"
                default n
                if BSP_USING_I2C1
                    config BSP_I2C1_SCL_PIN
                        int "i2c1 SCL pin number"
                        range 1 63
                        default 3
                    config BSP_I2C1_SDA_PIN
                        int "i2c1 SDA pin number"
                        range 1 63
                        default 17
                endif
            config BSP_USING_I2C2
                bool "Enable I2C2 Bus (User I2C)"
                default n
                if BSP_USING_I2C2
                    config BSP_I2C2_SCL_PIN
                        int "i2c2 SCL pin number"
                        range 1 63
                        default 26
                    config BSP_I2C2_SDA_PIN
                        int "i2c2 SDA pin number"
                        range 1 63
                        default 27
                endif
        endif

    menuconfig BSP_USING_PWM
        bool "Enable PWM"
        default n
        select RT_USING_PWM
        if BSP_USING_PWM
        menuconfig BSP_USING_PWM4
            bool "Enable timer2 output PWM"
            default n
            if BSP_USING_PWM4
                config BSP_USING_PWM4_CH1
                    bool "Enable PWM4 channel 1"
                    default n

                config BSP_USING_PWM4_CH2
                    bool "Enable PWM4 channel 2"
                    default n

                config BSP_USING_PWM4_CH3
                    bool "Enable PWM4 channel 3"
                    default n

                config BSP_USING_PWM4_CH4
                    bool "Enable PWM4 channel 4"
                    default n
            endif
        endif

    menuconfig BSP_USING_PULSE_ENCODER
        bool "Enable Pulse Encoder"
        default n
        select RT_USING_PULSE_ENCODER
        if BSP_USING_PULSE_ENCODER
            config BSP_USING_PULSE_ENCODER2
                bool "Enable Pulse Encoder2"
                default n

            config BSP_USING_PULSE_ENCODER3
                bool "Enable Pulse Encoder3"
                default n
        endif

    source "libraries/HAL_Drivers/Kconfig"
    
endmenu

menu "Board extended module Drivers"

endmenu

endmenu
```
